// Schedules
SchD = new Array( 0x01, 0x02, 0x04, 0x08, 0x10, 0x20, 0x40, 0x03, 0x06, 0xE0, 0x18, 0x30, 0x60, 0x41, 0x00, 0x00 );
SchH = new Array( 0, 1, 2, 3, 4, 5, 6, 7, 8, 9, 10, 11, 12, 13, 14, 15 );
SchM = new Array( 00, 10, 20, 30, 40, 50, 00, 10, 20, 30, 40, 50, 00, 10, 20, 30 );
SchB1 = new Array( 0xA0, 0xA1, 0xA2, 0xA3, 0xA4, 0xA5, 0xA6, 0xA7, 0xA8, 0xA9, 0xAA, 0xAB, 0xAC, 0xAD, 0x80, 0x81 ); 
SchB2 = new Array( 0, 1, 2, 3, 4, 5, 6, 7, 0x80, 0x81, 0x82, 0x83, 0x44, 0x45, 0x46, 0x47 );
SchB3 = new Array( 0, 1, 2, 3, 4, 5, 6, 7, 0, 1, 2, 3, 4, 5, 6, 7 );
SchB4 = new Array( 0, 1, 2, 3, 4, 5, 6, 7, 0, 1, 2, 3, 4, 5, 6, 7 );

//Scenes
ScDM = new Array( 0x0F, 0xF0, 0xF0, 0xF0, 0xF0, 0xF0, 0xF0, 0xF0, 0xF0, 0xF0, 0xF0, 0xF0 );
ScDS = new Array( 0x05, 0xA0, 0x05, 0xA0, 0x05, 0xA0, 0x05, 0xA0, 0x05, 0xA0, 0x05, 0xA0 );
ScAM = new Array( 0x05, 0x0A, 0x05, 0x0A, 0x05, 0x0A, 0x05, 0x0A, 0x05, 0x0A, 0x05, 0x0A );
ScAS = new Array( 0x0307, 0x1050, 0x0307, 0x1050, 0x0307, 0x1050, 0x0307, 0x1050, 0x0307, 0x1050, 0x0307, 0x1050 );
